## config/west.yml
```yaml
manifest:
  remotes:
    # - name: zmkfirmware
    #   url-base: https://github.com/zmkfirmware
    - name: mcanueste
      url-base: https://github.com/mcanueste
  projects:
    - name: zmk
      remote: mcanueste
      revision: main
      import: app/west.yml
  self:
    path: config
```
